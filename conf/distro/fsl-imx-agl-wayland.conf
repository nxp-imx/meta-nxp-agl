## conf/distro/fsl-imx-agl-wayland.conf
```bitbake
# i.MX DISTRO for AGL Wayland without X11

DISTRO = "fsl-imx-agl-wayland"

# From 6QP_GA fsl-imx-wayland distro
# Remove conflicting backends
DISTRO_FEATURES_remove = "directfb x11 "
DISTRO_FEATURES_append = " wayland"

PREFERRED_PROVIDER_virtual/mesa_mx6q = ""
PREFERRED_PROVIDER_virtual/mesa_mx6dl = ""
PREFERRED_PROVIDER_virtual/mesa_mx6sx = ""
PREFERRED_PROVIDER_virtual/mesa_mx6sl = ""

# From 6QP_GA include file
# Add the ability to specify _imx machines (temporarily here)
MACHINEOVERRIDES =. "imx:"

# Comment out the 2 lines below to use bluez4.
DISTRO_FEATURES_append_mx6 = " bluez5"
DISTRO_FEATURES_append_mx7 = " bluez5"

# Preferred Providers
PREFERRED_PROVIDER_u-boot_mx5 = "u-boot-fslc"
PREFERRED_PROVIDER_u-boot_mx6 = "u-boot-imx"
PREFERRED_PROVIDER_u-boot_mx7 = "u-boot-imx"

PREFERRED_PROVIDER_virtual/kernel_mx6 = "linux-imx"
PREFERRED_PROVIDER_virtual/kernel_mx7 = "linux-imx"

PREFERRED_PROVIDER_virtual/libgal-x11_mx6 = "imx-gpu-viv"
PREFERRED_PROVIDER_virtual/libopenvg_mx6q = "imx-gpu-viv"
PREFERRED_PROVIDER_virtual/libopenvg_mx6dl = "imx-gpu-viv"
PREFERRED_PROVIDER_virtual/libopenvg_mx6sx = "imx-gpu-viv"
PREFERRED_PROVIDER_virtual/libopenvg_mx6sl = "imx-gpu-viv"

# Preferred Versions

# set these because of meta-fsl-arm override to new xorg version
PREFERRED_VERSION_xserver-xorg_mx6q = "2:1.17.2"
PREFERRED_VERSION_xserver-xorg_mx6dl = "2:1.17.2"
PREFERRED_VERSION_xserver-xorg_mx6s = "2:1.17.2"
PREFERRED_VERSION_xserver-xorg_mx6sl = "2:1.17.2"
PREFERRED_VERSION_xserver-xorg_mx6sx = "2:1.17.2"
PREFERRED_VERSION_xserver-xorg_mx6ul = "2:1.17.2"
PREFERRED_VERSION_xserver-xorg_mx7 = "2:1.17.2"

PREFERRED_VERSION_xtrans = "1.3.5"

# preferred versions of recipes-graphics
FP_TAG = "${@base_contains("TUNE_FEATURES", "callconvention-hard", "-hfp", "-sfp", d)}"

PREFERRED_VERSION_imx-gpu-viv = "5.0.11.p7.1${FP_TAG}"
PREFERRED_VERSION_xf86-video-imxfb-vivante = "5.0.11.p7.1"
PREFERRED_VERSION_kernel-module-imx-gpu-viv = "5.0.11.p7.1"

PREFERRED_VERSION_fsl-gpu-sdk_mx6 = "2.2"

# Use Wayland new version
BBMASK = "meta-fsl-arm/recipes-graphics/wayland/weston_%.bbappend"
BBMASK .= "|meta-agl-demo/recipes-graphics/wayland/weston_1.5.0.bbappend"
BBMASK .= "|meta-ivi-common/recipes-graphics/wayland/weston_1.5.0.bbappend"
BBMASK .= "|meta-agl-demo/recipes-qt/qt5/qtwayland_%.bbappend"
BBMASK .= "|meta-agl-demo/recipes-qt/qt5/qtbase_5.%.bbappend"
BBMASK .= "|meta-agl-demo/recipes-qt/qt5/qtwebkit_5.%.bbappend"
BBMASK .= "|meta-fsl-arm/recipes-graphics/mesa/mesa_%.bbappend"

# Remove the GST patch on the community
BBMASK .= "|meta-fsl-arm/recipes-multimedia/gstreamer/gstreamer1.0-plugins-base_%.bbappend"
PREFERRED_VERSION_wayland_mx6 = "1.8.1"
PREFERRED_VERSION_weston_mx6 = "1.8.0"
PREFERRED_VERSION_wayland-native = "1.8.1"
PREFERRED_VERSION_libinput_mx6 = "0.11.0"

# Preferred versions of recipes-bsp
PREFERRED_VERSION_imx-vpu_mx5 = "11.09.02"
PREFERRED_VERSION_imx-vpu_mx6 = "5.4.31"
PREFERRED_VERSION_imx-lib_mx5 = "11.09.02"
PREFERRED_VERSION_imx-lib_mx6 = "5.1"
PREFERRED_VERSION_imx-lib_mx7 = "5.1"
PREFERRED_VERSION_imx-test = "5.2"
PREFERRED_VERSION_imx-uuc = "0.5"
PREFERRED_VERSION_imx-kobs = "5.1"
PREFERRED_VERSION_firmware-imx = "5.2"
PREFERRED_VERSION_u-boot-imx_mx6 = "2015.04"
PREFERRED_VERSION_u-boot-imx_mx7 = "2015.04"
PREFERRED_VERSION_u-boot-imx-mfgtool_mx6 = "2015.04"
PREFERRED_VERSION_u-boot-imx-mfgtool_mx7 = "2015.04"

# preferred versions of recipes-kernel
PREFERRED_VERSION_linux-libc-headers = "3.14"
PREFERRED_VERSION_linux-imx_mx6 = "3.14.38"
PREFERRED_VERSION_linux-imx_mx7 = "3.14.38"
PREFERRED_VERSION_mfgtool-linux-imx_mx6 = "3.14.38"
PREFERRED_VERSION_mfgtool-linux-imx_mx7 = "3.14.38"
PREFERRED_VERSION_linux-mfgtool_mx6 = "3.14.38"
PREFERRED_VERSION_linux-imx-mfg_mx6 = "3.14.38"
PREFERRED_VERSION_linux-mfgtool_mx7 = "3.14.38"
PREFERRED_VERSION_linux-imx-mfg_mx7 = "3.14.38"

# preferred versions of recipes-multimedia
PREFERRED_VERSION_gst-fsl-plugin = "4.0.3"
PREFERRED_VERSION_libfslcodec = "4.0.7"
PREFERRED_VERSION_libfslparser = "4.0.7"
PREFERRED_VERSION_libfslvpuwrap = "1.0.61"
PREFERRED_VERSION_gst1.0-fsl-plugin = "4.0.7"
PREFERRED_VERSION_fsl-alsa-plugins = "1.0.25"
PREFERRED_VERSION_gst-plugins-gl = "0.10.3"
PREFERRED_VERSION_fslqtapplications = "1.0.5"

MACHINE_GSTREAMER_1_0_PLUGIN_mx6 = "gst1.0-fsl-plugin"
MACHINE_GSTREAMER_1_0_PLUGIN_mx6q = "gst1.0-fsl-plugin"
MACHINE_GSTREAMER_1_0_PLUGIN_mx6dl = "gst1.0-fsl-plugin"
MACHINE_GSTREAMER_1_0_PLUGIN_mx6sl = "gst1.0-fsl-plugin"
MACHINE_GSTREAMER_1_0_PLUGIN_mx6sx = "gst1.0-fsl-plugin"
MACHINE_GSTREAMER_1_0_PLUGIN_mx7 = "gst1.0-fsl-plugin"

MACHINE_GSTREAMER_PLUGIN_mx6ul = ""
MACHINE_GSTREAMER_PLUGIN_mx6qp = ""
MACHINE_GSTREAMER_PLUGIN_mx7 = ""

DEFAULTTUNE_mx6 ?= "cortexa9hf-neon"
DEFAULTTUNE_mx6ul ?= "cortexa7hf-neon"
DEFAULTTUNE_mx7 ?= "cortexa7hf-neon"

SANITY_TESTED_DISTROS += " \
    Ubuntu-12.04 \n \
"

# Additions needed for AGL
PREFERRED_VERSION_gstreamer1.0              ?= "1.4.%"
PREFERRED_VERSION_gstreamer1.0-plugins-bad  ?= "1.4.%"
PREFERRED_VERSION_gstreamer1.0-plugins-base ?= "1.4.%"
PREFERRED_VERSION_gstreamer1.0-plugins-good ?= "1.4.%"
PREFERRED_VERSION_gstreamer1.0-plugins-ugly ?= "1.4.%"
PREFERRED_VERSION_gstreamer1.0-libav        ?= "1.4.%"
PREFERRED_VERSION_gstreamer1.0-omx          ?= "1.2.%"


# From AGL poky-agl distro
PREFERRED_PROVIDER_udev ?= "systemd"
PREFERRED_PROVIDER_udev-utils ?= "systemd"

VIRTUAL-RUNTIME_init_manager = "systemd"
VIRTUAL-RUNTIME_initscripts = ""

# Override these in poky based distros
AGL_DEFAULT_DISTRO_FEATURES = "systemd opengl wayland pam"
AGL_DEFAULT_EXTRA_RDEPENDS = "packagegroup-core-boot"
AGL_DEFAULT_EXTRA_RRECOMMENDS = "kernel-module-af-packet"

DISTRO_FEATURES ?= "${DISTRO_FEATURES_DEFAULT} ${DISTRO_FEATURES_LIBC} ${AGL_DEFAULT_DISTRO_FEATURES}"

DISTRO_FEATURES_BACKFILL_CONSIDERED = "sysvinit"

SDK_NAME = "${DISTRO}-${TCLIBC}-${SDK_ARCH}-${IMAGE_BASENAME}-${TUNE_PKGARCH}"
SDKPATH = "/opt/${DISTRO}/${SDK_VERSION}"

EXTRAOPKGCONFIG = "poky-feed-config-opkg"

DISTRO_EXTRA_RDEPENDS += " ${AGL_DEFAULT_EXTRA_RDEPENDS}"
DISTRO_EXTRA_RRECOMMENDS += " ${AGL_DEFAULT_EXTRA_RRECOMMENDS}"
OELAYOUT_ABI = "8"

# add poky sanity bbclass
INHERIT += "poky-sanity"

# QA check settings - a little stricter than the OE-Core defaults
WARN_QA = "textrel files-invalid incompatible-license xorg-driver-abi libdir \
           unknown-configure-option build-deps file-rdeps"
ERROR_QA = "dev-so debug-deps dev-deps debug-files arch pkgconfig la perms \
            useless-rpaths rpaths staticdev ldflags pkgvarcheck already-stripped \
            compile-host-path dep-cmp installed-vs-shipped install-host-path \
            packages-list perm-config perm-line perm-link pkgv-undefined \
            pn-overrides split-strip var-undefined version-going-backwards"

IMAGE_INSTALL_append = " \
    weston-ivi-shell-config \
    "
```

## conf/distro/imx-agl-wayland.conf
```bitbake
# i.MX DISTRO for AGL Wayland without X11
require conf/distro/poky-agl.conf
require conf/include/agl-appfw-smack.inc
require conf/distro/fsl-imx-wayland.conf

DISTRO = "imx-agl-wayland"

# Use systemd instead of connman.
VIRTUAL-RUNTIME_net_manager = "systemd"

SECURITY_CFLAGS_pn-optee-client-imx = ""

PREFERRED_VERSION_wayland-protocols = "1.18.imx"
PREFERRED_VERSION_weston = "7.0.0.imx"
```

## conf/distro/nxp-imx-agl-wayland.conf
```bitbake
# i.MX DISTRO for AGL Wayland without X11

include conf/distro/fsl-imx-wayland.conf

DISTRO = "nxp-imx-agl-wayland"

PREFERRED_PROVIDER_jpeg ?= "libjpeg-turbo"

PREFERRED_VERSION_weston ?= "1.11.0"

PREFERRED_VERSION_gstreamer1.0 ?= "1.8.3"
PREFERRED_VERSION_gstreamer1.0-plugins-bad ?= "1.8.3"
PREFERRED_VERSION_gstreamer1.0-plugins-base ?= "1.8.3"
PREFERRED_VERSION_gstreamer1.0-plugins-good ?= "1.8.3"
PREFERRED_VERSION_gstreamer1.0-plugins-ugly ?= "1.8.3"

FP_TAG = "-hfp"

# Replacing this file with our own
BBMASK += "/meta-fsl-bsp-release/imx/meta-bsp/recipes-graphics/wayland/weston-init.bbappend"
# Mask out recipes not needed
# meta-qt5:pyro no longer provides qtwayland-native as a recipe to append to
BBMASK += "/meta-agl-demo/recipes-qt/qt5/qtwayland-native_%.bbappend"
# This is already in Poky
BBMASK += "/meta-agl/meta-agl/recipes-graphics/wayland/weston_%.bbappend"
# This pulls in some patches that break imx8 builds
BBMASK += "/meta-freescale/recipes-multimedia/gstreamer/gstreamer1.0-plugins-bad_1.8.%.bbappend"

# From AGL poky-agl distro
PREFERRED_PROVIDER_udev ?= "systemd"
PREFERRED_PROVIDER_udev-utils ?= "systemd"

VIRTUAL-RUNTIME_init_manager = "systemd"
VIRTUAL-RUNTIME_initscripts = ""

# Override these in poky based distros
AGL_DEFAULT_DISTRO_FEATURES = " systemd opengl wayland pam bluetooth bluez5"
AGL_DEFAULT_EXTRA_RDEPENDS = "packagegroup-core-boot"
AGL_DEFAULT_EXTRA_RRECOMMENDS = "kernel-module-af-packet"

DISTRO_FEATURES_append = "${DISTRO_FEATURES_DEFAULT} ${DISTRO_FEATURES_LIBC} ${AGL_DEFAULT_DISTRO_FEATURES}"

# These are not really redundant since the DISTRO name is different
SDK_NAME = "${DISTRO}-${TCLIBC}-${SDK_ARCH}-${IMAGE_BASENAME}-${TUNE_PKGARCH}"
SDKPATH = "/opt/${DISTRO}/${SDK_VERSION}"

DISTRO_EXTRA_RDEPENDS += " ${AGL_DEFAULT_EXTRA_RDEPENDS}"
DISTRO_EXTRA_RRECOMMENDS += " ${AGL_DEFAULT_EXTRA_RRECOMMENDS}"

IMAGE_INSTALL_append = " weston-init weston-ivi-shell-config"
```

## conf/layer.conf
```bitbake
# We have a conf and classes directory, add to BBPATH
BBPATH .= ":${LAYERDIR}"

# We have recipes-* directories, add to BBFILES
BBFILES += "${LAYERDIR}/recipes-*/*/*.bb ${LAYERDIR}/recipes-*/*/*.bbappend"

BBFILE_COLLECTIONS += "nxp-agl"
BBFILE_PATTERN_nxp-agl := "^${LAYERDIR}"
BBFILE_PRIORITY_nxp-agl = "8"

BBMASK += "/meta-agl/meta-agl-profile-core/recipes-support/opencv/opencv_4.%.bbappend"
BBMASK += "/meta-agl-demo/recipes-graphics/ttf-fonts/ttf-noto-emoji_20190815.bb"
TTF_FONTS:remove = "ttf-noto-emoji-color"

LAYERSERIES_COMPAT_nxp-agl = "kirkstone"
```
